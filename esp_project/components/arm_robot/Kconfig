## esp_project/components/arm_robot/Kconfig
```kconfig
menu "Arm robot configuration"

    config PWM_FREQUENCY
        int "PWM frequency"
        default 50
        help
            Set pwm frequency.

    menu "Servo base"

        config SERVO_BASE_START_ANGLE
            int "Servo base start angle"
            range 0 180
            default 90
            help
                Set start angle for servo base in degress.

        config SERVO_BASE_NUMBER_PWM
            int "Servo base number pwm"
            range 0 15
            default 10
            help
                Set number pwm for servo base.

        config SERVO_BASE_MAX_ANGLE
            int "Servo base maximum angle"
            range 0 360
            default 180
            help
                Set the maximum angle for servo base in degrees.

        config SERVO_BASE_MIN_PULSE_US
            int "Servo base minimum pulse width"
            range 0 4096
            default 500
            help
                Set the minimum pulse width for servo base in microseconds.

        config SERVO_BASE_MAX_PULSE_US
            int "Servo base maximum pulse width"
            range 0 4096
            default 2500
            help
                Set the maximum pulse width for servo base in microseconds.
    
    endmenu

    menu "Servo shoulder"

        config SERVO_SHOULDER_START_ANGLE
            int "Servo shoulder start angle"
            range 0 180
            default 90
            help
                Set start angle for servo base in degress.

        config SERVO_SHOULDER_NUMBER_PWM
            int "Servo shoulder number pwm"
            range 0 15
            default 11
            help
                Set number pwm for servo shoulder.

        config SERVO_SHOULDER_MAX_ANGLE
            int "Servo shoulder maximum angle"
            range 0 360
            default 180
            help
                Set the maximum angle for servo shoulder in degrees.

        config SERVO_SHOULDER_MIN_PULSE_US
            int "Servo shoulder minimum pulse width"
            range 0 4096
            default 500
            help
                Set the minimum pulse width for servo shoulder in microseconds.

        config SERVO_SHOULDER_MAX_PULSE_US
            int "Servo shoulder maximum pulse width"
            range 0 4096
            default 2500
            help
                Set the maximum pulse width for servo shoulder in microseconds.
    
    endmenu

    menu "Servo elbow"

        config SERVO_ELBOW_START_ANGLE
            int "Servo elbow start angle"
            range 0 180
            default 90
            help
                Set start angle for servo elbow in degress.

        config SERVO_ELBOW_NUMBER_PWM
            int "Servo elbow number pwm"
            range 0 15
            default 12
            help
                Set number pwm for servo elbow.

        config SERVO_ELBOW_MAX_ANGLE
            int "Servo elbow maximum angle"
            range 0 360
            default 180
            help
                Set the maximum angle for servo elbow in degrees.

        config SERVO_ELBOW_MIN_PULSE_US
            int "Servo elbow minimum pulse width"
            range 0 4096
            default 500
            help
                Set the minimum pulse width for servo elbow in microseconds.

        config SERVO_ELBOW_MAX_PULSE_US
            int "Servo elbow maximum pulse width"
            range 0 4096
            default 2500
            help
                Set the maximum pulse width for servo elbow in microseconds.
    
    endmenu

    menu "Servo wrist"

        config SERVO_WRIST_START_ANGLE
            int "Servo wrist start angle"
            range 0 180
            default 90
            help
                Set start angle for servo wrist in degress.

        config SERVO_WRIST_NUMBER_PWM
            int "Servo wrist number pwm"
            range 0 15
            default 13
            help
                Set number pwm for servo wrist.

        config SERVO_WRIST_MAX_ANGLE
            int "Servo wrist maximum angle"
            range 0 360
            default 180
            help
                Set the maximum angle for servo wrist in degrees.

        config SERVO_WRIST_MIN_PULSE_US
            int "Servo wrist minimum pulse width"
            range 0 4096
            default 500
            help
                Set the minimum pulse width for servo wrist in microseconds.

        config SERVO_WRIST_MAX_PULSE_US
            int "Servo wrist maximum pulse width"
            range 0 4096
            default 2500
            help
                Set the maximum pulse width for servo wrist in microseconds.
    
    endmenu

    menu "Servo wrist rotational"

        config SERVO_WRIST_ROT_START_ANGLE
            int "Servo wrist rotational start angle"
            range 0 180
            default 90
            help
                Set start angle for servo wrist rotational in degress.

        config SERVO_WRIST_ROT_NUMBER_PWM
            int "Servo wrist rotational number pwm"
            range 0 15
            default 14
            help
                Set number pwm for servo wrist rotational.

        config SERVO_WRIST_ROT_MAX_ANGLE
            int "Servo wrist rotational maximum angle"
            range 0 360
            default 180
            help
                Set the maximum angle for servo wrist rotational in degrees.

        config SERVO_WRIST_ROT_MIN_PULSE_US
            int "Servo wrist rotational minimum pulse width"
            range 0 4096
            default 500
            help
                Set the minimum pulse width for servo wrist rotational in microseconds.

        config SERVO_WRIST_ROT_MAX_PULSE_US
            int "Servo wrist rotational maximum pulse width"
            range 0 4096
            default 2500
            help
                Set the maximum pulse width for servo wrist rotational in microseconds.
    
    endmenu

    menu "Servo gripper"

        config SERVO_GRIPPER_START_ANGLE
            int "Servo gripper start angle"
            range 0 180
            default 90
            help
                Set start angle for servo gripper in degress.

        config SERVO_GRIPPER_NUMBER_PWM
            int "Servo gripper number pwm"
            range 0 15
            default 15
            help
                Set number pwm for servo gripper.

        config SERVO_GRIPPER_MAX_ANGLE
            int "Servo gripper maximum angle"
            range 0 360
            default 180
            help
                Set the maximum angle for servo gripper in degrees.

        config SERVO_GRIPPER_MIN_PULSE_US
            int "Servo gripper minimum pulse width"
            range 0 4096
            default 500
            help
                Set the minimum pulse width for servo gripper in microseconds.

        config SERVO_GRIPPER_MAX_PULSE_US
            int "Servo gripper maximum pulse width"
            range 0 4096
            default 2500
            help
                Set the maximum pulse width for servo gripper in microseconds.
    
    endmenu

endmenu
```
